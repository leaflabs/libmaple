/* ISR names for STM32 (by Lanchon) */

EXTERN (__cs3_stack)
EXTERN (__cs3_reset)
EXTERN (NMIException)
EXTERN (HardFaultException)
EXTERN (MemManageException)
EXTERN (BusFaultException)
EXTERN (UsageFaultException)
EXTERN (__STM32ReservedException7)
EXTERN (__STM32ReservedException8)
EXTERN (__STM32ReservedException9)
EXTERN (__STM32ReservedException10)
EXTERN (SVCHandler)
EXTERN (DebugMonitor)
EXTERN (__STM32ReservedException13)
EXTERN (PendSVC)
EXTERN (SysTickHandler)
EXTERN (WWDG_IRQHandler)
EXTERN (PVD_IRQHandler)
EXTERN (TAMPER_IRQHandler)
EXTERN (RTC_IRQHandler)
EXTERN (FLASH_IRQHandler)
EXTERN (RCC_IRQHandler)
EXTERN (EXTI0_IRQHandler)
EXTERN (EXTI1_IRQHandler)
EXTERN (EXTI2_IRQHandler)
EXTERN (EXTI3_IRQHandler)
EXTERN (EXTI4_IRQHandler)
EXTERN (DMAChannel1_IRQHandler)
EXTERN (DMAChannel2_IRQHandler)
EXTERN (DMAChannel3_IRQHandler)
EXTERN (DMAChannel4_IRQHandler)
EXTERN (DMAChannel5_IRQHandler)
EXTERN (DMAChannel6_IRQHandler)
EXTERN (DMAChannel7_IRQHandler)
EXTERN (ADC_IRQHandler)
EXTERN (USB_HP_CAN_TX_IRQHandler)
EXTERN (USB_LP_CAN_RX0_IRQHandler)
EXTERN (CAN_RX1_IRQHandler)
EXTERN (CAN_SCE_IRQHandler)
EXTERN (EXTI9_5_IRQHandler)
EXTERN (TIM1_BRK_IRQHandler)
EXTERN (TIM1_UP_IRQHandler)
EXTERN (TIM1_TRG_COM_IRQHandler)
EXTERN (TIM1_CC_IRQHandler)
EXTERN (TIM2_IRQHandler)
EXTERN (TIM3_IRQHandler)
EXTERN (TIM4_IRQHandler)
EXTERN (I2C1_EV_IRQHandler)
EXTERN (I2C1_ER_IRQHandler)
EXTERN (I2C2_EV_IRQHandler)
EXTERN (I2C2_ER_IRQHandler)
EXTERN (SPI1_IRQHandler)
EXTERN (SPI2_IRQHandler)
EXTERN (USART1_IRQHandler)
EXTERN (USART2_IRQHandler)
EXTERN (USART3_IRQHandler)
EXTERN (EXTI15_10_IRQHandler)
EXTERN (RTCAlarm_IRQHandler)
EXTERN (USBWakeUp_IRQHandler)
